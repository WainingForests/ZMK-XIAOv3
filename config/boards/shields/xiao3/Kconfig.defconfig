## config/boards/shields/xiao3/Kconfig.defconfig
```kconfig
if SHIELD_XIAO3_RIGHT

config ZMK_KEYBOARD_NAME
    default "Skree Custom"

config ZMK_SPLIT_ROLE_CENTRAL
    default y

endif

if SHIELD_XIAO3_LEFT || SHIELD_XIAO3_RIGHT

config ZMK_SPLIT
    default y

endif
```
